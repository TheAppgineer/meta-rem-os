## conf/distro/rem-os.conf
```bitbake
require conf/distro/poky.conf

DISTRO = "rem-os"
DISTRO_NAME = "Roon Extension Manager OS"
DISTRO_VERSION = "0.1.0"
DISTRO_CODENAME = "Amstel"

DISTRO_FEATURES:append = " virtualization systemd"
DISTRO_FEATURES_BACKFILL_CONSIDERED = "sysvinit"
VIRTUAL-RUNTIME_init_manager = "systemd"
VIRTUAL-RUNTIME_initscripts = ""

hostname:pn-base-files = "REM-OS"

DISTRO_FEATURES:remove = " 3g ipv6 nfc nfs"
DISTRO_FEATURES:remove:raspberrypi2 = " bluetooth"

RPI_KERNEL_DEVICETREE_OVERLAYS:append = " \
    overlays/hifiberry-dacplusadc.dtbo \
    overlays/hifiberry-dacplusadcpro.dtbo \
    overlays/hifiberry-dacplusdsp.dtbo \
    overlays/hifiberry-dacplushd.dtbo \
    overlays/hifiberry-digi-pro.dtbo \
"
```

## conf/layer.conf
```bitbake
# We have a conf and classes directory, add to BBPATH
BBPATH .= ":${LAYERDIR}"

# We have recipes-* directories, add to BBFILES
BBFILES += "${LAYERDIR}/recipes-*/*/*.bb \
	${LAYERDIR}/recipes-*/*/*.bbappend"

BBFILE_COLLECTIONS += "rem-os"
BBFILE_PATTERN_rem-os = "^${LAYERDIR}/"
BBFILE_PRIORITY_rem-os = "5"

LAYERSERIES_COMPAT_rem-os = "honister"
```
